## config/boards/shields/heartbreak/Kconfig.defconfig
```kconfig
# Copyright (c) 2022 The ZMK Contributors
# SPDX-License-Identifier: MIT

# ---------------------------------------------------

if SHIELD_HEARTBREAK_LEFT

config ZMK_KEYBOARD_NAME
	default "Heartbreak"

config ZMK_SPLIT_ROLE_CENTRAL
	default y

if ZMK_DISPLAY

config NICE_VIEW_WIDGET_STATUS
    select LV_FONT_MONTSERRAT_18
    select LV_FONT_MONTSERRAT_14
    select LV_FONT_UNSCII_8
    select ZMK_WPM

endif # ZMK_DISPLAY

endif # SHIELD_HEARTBREAK_LEFT

# ---------------------------------------------------

if SHIELD_HEARTBREAK_LEFT || SHIELD_HEARTBREAK_RIGHT

config ZMK_SPLIT
	default y

if ZMK_DISPLAY

config ZMK_DISPLAY
	select LVGL_FONT_MONTSERRAT_26

config ZMK_DISPLAY_STATUS_SCREEN_BUILT_IN
    select LV_FONT_MONTSERRAT_26

config LV_Z_VDB_SIZE
    default 100

config LV_Z_DPI
    default 161

config LV_Z_BITS_PER_PIXEL
    default 1

choice LV_COLOR_DEPTH
    default LV_COLOR_DEPTH_1
endchoice

choice ZMK_DISPLAY_WORK_QUEUE
    default ZMK_DISPLAY_WORK_QUEUE_DEDICATED
endchoice

choice ZMK_DISPLAY_STATUS_SCREEN
    default ZMK_DISPLAY_STATUS_SCREEN_CUSTOM
endchoice

config ZMK_DISPLAY_STATUS_SCREEN_CUSTOM
    imply NICE_VIEW_WIDGET_STATUS

config NICE_VIEW_WIDGET_STATUS
    bool "Custom nice!view status widget"
    select LV_FONT_MONTSERRAT_16
    select LV_USE_IMG
    select LV_USE_CANVAS

config NICE_VIEW_WIDGET_INVERTED
    bool "Invert custom status widget colors"

endif # ZMK_DISPLAY

endif # SHIELD_HEARTBREAK_LEFT || SHIELD_HEARTBREAK_RIGHT
```

## config/boards/shields/heartbreak/Kconfig.shield
```kconfig
#Copyright (c) 2022 The ZMK Contributors
#SPDX-License-Identifier: MIT

config SHIELD_HEARTBREAK_LEFT
	def_bool $(shields_list_contains,heartbreak_left)

config SHIELD_HEARTBREAK_RIGHT
	def_bool $(shields_list_contains,heartbreak_right)
```

## config/west.yml
```yaml
manifest:
  remotes:
    - name: zmkfirmware
      url-base: https://github.com/nnandrew
  projects:
    - name: zmk
      remote: zmkfirmware
      revision: main
      import: app/west.yml
  self:
    path: config
```
